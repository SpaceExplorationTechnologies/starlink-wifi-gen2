## openwrt/package/mtk/applications/bluedroid/Config.in
```kconfig
if PACKAGE_bluedroid
config MTK_VENDOR_LIB_HCI_TYPE
	bool "HCI Type Vendor Library"
	default n
	depends on PACKAGE_bluedroid

endif #PACKAGE_bluedroid#
```

## openwrt/package/mtk/drivers/mt_wifi/src/mt_wifi_ap/Kconfig
```kconfig
config MT_AP_SUPPORT
	tristate "Ralink RT2860 802.11n AP support"
#	depends on NET_RADIO 
	select WIRELESS_EXT
	select WEXT_SPY
	select WEXT_PRIV

config WDS_SUPPORT
	bool "WDS"
	depends on MT_AP_SUPPORT
	default y

config WIFI_EAP_FEATURE
	bool "EAP Feature"
    depends on WIFI_DRIVER
	default y

config VLAN_SUPPORT
	bool "VLAN support"
	depends on MT_AP_SUPPORT && WIFI_EAP_FEATURE
	default n

config SNIFFER_SUPPORT
	bool "SNIFFER"
	depends on MT_AP_SUPPORT && WIFI_EAP_FEATURE
	default n

config TXRX_STAT_SUPPORT
	bool "TxRx Stats Support"
	depends on WIFI_DRIVER && WIFI_EAP_FEATURE
	default n

config ANTENNA_CONTROL_SUPPORT
	bool "Antenna Control"
	depends on MT_AP_SUPPORT && WIFI_EAP_FEATURE
	default n

config MGMT_TXPWR_CTRL
	bool "Mgmt TxPower Control"
	depends on MT_AP_SUPPORT && WIFI_EAP_FEATURE
	default n

config CHUTIL_SUPPORT
	bool "Channel Utilization Support"
	depends on MT_AP_SUPPORT && WIFI_EAP_FEATURE
	default n

config NF_SUPPORT
	bool "Noise Floor Support"
	depends on MT_AP_SUPPORT && WIFI_EAP_FEATURE
	default n

config RA_PHY_RATE_SUPPORT
	bool "RA PHY RATE Support"
	depends on MT_AP_SUPPORT && WIFI_EAP_FEATURE
	default n

config AMPDU_CONF_SUPPORT
	bool "AMPDU Config retry & agglimitSupport"
	depends on MT_AP_SUPPORT && WIFI_EAP_FEATURE
	default n

config ACK_CTS_TIMEOUT_SUPPORT
	bool "ACK CTS Timeout cck & ofdm Support"
	depends on MT_AP_SUPPORT && WIFI_EAP_FEATURE
	default n

config WIFI_GPIO_CTRL
	bool "GPIO Control"
    depends on WIFI_DRIVER
	default y

config MBSS_SUPPORT
	bool "MBSSID"
	depends on MT_AP_SUPPORT
	default y

config MIN_PHY_RATE_SUPPORT
	bool "Min-PHY Rate Support"
	depends on WIFI_DRIVER
	default n

#config NEW_MBSSID_MODE
#	bool "New MBSSID MODE"
#	depends on MT_AP_SUPPORT && MBSS_SUPPORT
#	depends on RALINK_RT3883 || RALINK_RT3352 || RALINK_RT5350 || RALINK_RT6352 || RALINK_MT7620
#	default y

#config ENHANCE_NEW_MBSSID_MODE
#	bool "Enhanced MBSSID mode"
#	depends on NEW_MBSSID_MODE
#	default y

config APCLI_SUPPORT
	bool "AP-Client Support"
	depends on MT_AP_SUPPORT
	default y

config APCLI_CERT_SUPPORT
	bool "AP-Client TGn Cert Support"
	depends on MT_AP_SUPPORT
	depends on APCLI_SUPPORT
	default n

config MAC_REPEATER_SUPPORT
	bool "MAC Repeater Support"
	depends on MT_AP_SUPPORT
	depends on APCLI_SUPPORT
	depends on RALINK_RT6352 || RALINK_MT7620 || RALINK_MT7603E || MT_AP_SUPPORT
	default y

config MWDS
    bool "Mixed WDS(MWDS)"
    depends on CHIP_MT7615E && !MT76XX_COMBO_DUAL_DRIVER_SUPPORT
    depends on MT_AP_SUPPORT
    select APCLI_SUPPORT
    default n

config MUMIMO_SUPPORT
	bool "MU-MIMO Support"
	depends on WIFI_DRIVER
	select MU_RA_SUPPORT
	default y

config MU_RA_SUPPORT
  	bool "MU-RGA Support"
  	depends on MUMIMO_SUPPORT
  	
config DOT11R_FT_SUPPORT
	bool "802.11r Fast BSS Transition"
	depends on MT_AP_SUPPORT
	default n

config DOT11K_RRM_SUPPORT
	bool "802.11k Radio Resource Management"
	depends on MT_AP_SUPPORT
	default n

config KVRH_SUPPORT
	bool "Query STA 802.11k/v/r/h Capability"
	depends on MT_AP_SUPPORT
	default n
config INTERWORKING
	bool "802.11u Interworking/Gas Support"
        depends on MT_AP_SUPPORT
        default n

config MAP_SUPPORT
	bool "Multi-AP Support"
	depends on MT_AP_SUPPORT
	#select MBO_SUPPORT
	select WAPP_SUPPORT
	default n
config OFFCHANNEL_SCAN_FEATURE
        bool "Channel Quality Monitor"
        depends on MT_AP_SUPPORT
        default y

config WAPP_SUPPORT
	bool "WAPP Support"
	depends on MT_AP_SUPPORT
        select INTERWORKING
        select WNM_SUPPORT
        select DOT11K_RRM_SUPPORT
        select DOT11R_FT_SUPPORT
        select DOT11W_PMF_SUPPORT
	default n

config OCE_SUPPORT
        bool "Optimized Connectivity Experience Support"
        depends on MT_AP_SUPPORT
	depends on CHIP_MT7663E
	select WAPP_SUPPORT
	default n

config WIFI_MSI_SUPPORT
        bool "MSI support"
        depends on PCI_MSI
        depends on CHIP_MT7615E && !MT76XX_COMBO_DUAL_DRIVER_SUPPORT
        default n

config CFG80211_SUPPORT
	bool "CFG80211"
	depends on MT_AP_SUPPORT
	default n

#config DSCP_PRI_SUPPORT
#	bool "Dscp Priority Mapping Support
#	depends on MT_AP_SUPPORT
#	default n

config DSCP_PRI_SUPPORT
	bool "Dscp Priority Mapping Support"
	depends on MT_AP_SUPPORT
	default n

config CON_WPS_SUPPORT
	bool "Concurrent WPS Support"
	depends on MT_AP_SUPPORT
	depends on APCLI_SUPPORT
	depends on WSC_INCLUDED
	depends on WSC_V2_SUPPORT
#	depends on MULTI_INF_SUPPORT
	default n
	
#config LLTD_SUPPORT
#	bool "LLTD (Link Layer Topology Discovery Protocol)"
#	depends on MT_AP_SUPPORT

#config COC_SUPPORT
#	bool "CoC Support"
#	depends on MT_AP_SUPPORT
#	default n

#config  RT2860V2_SNMP
#	bool "Net-SNMP Support"
#	depends on MT_AP_SUPPORT

config MCAST_RATE_SPECIFIC
	bool "User specific tx rate of mcast pkt"
	depends on MT_AP_SUPPORT
	default y

#config EXT_BUILD_CHANNEL_LIST
#	bool "Extension Channel List"
#	depends on MT_AP_SUPPORT

#config AUTO_CH_SELECT_ENHANCE
#	bool "Auto Channel Selection Enhancement"
#	depends on MT_AP_SUPPORT

config VOW_SUPPORT
	bool "MediaAir(VOW) support"
	depends on MT_AP_SUPPORT
	default y

#config AIRPLAY_SUPPORT
#	bool "AIRPLAY Support"
#	depends on MT_AP_SUPPORT
#	default n

config CUSTOMER_RSG_FEATURE
        bool "Customer RSG feature"
        depends on MT_AP_SUPPORT
        default n

config CUSTOMER_DCC_FEATURE
        bool "Customer DCC feature"
        depends on MT_AP_SUPPORT
        default n

config BAND_STEERING
	bool "Band Steering"
	depends on MT_AP_SUPPORT
	default y

config LED_CONTROL_SUPPORT
	bool "LED Control Support"
	default n

config WLAN_HOOK
	bool "WLAN hook Support"
	depends on WIFI_DRIVER
	default n

config RADIUS_ACCOUNTING_SUPPORT
	bool "Radius Accounting Support"
	depends on MT_AP_SUPPORT
	default n

config GREENAP_SUPPORT
	bool "GreenAP Support"
	depends on MT_AP_SUPPORT
	default y

config PCIE_ASPM_DYM_CTRL_SUPPORT
	bool "Pcie Aspm Dynamic Control Support"
	depends on MT_AP_SUPPORT
	default y

config COEX_SUPPORT
	bool "Coex Support"
	depends on MT_AP_SUPPORT
	default n

config EASY_SETUP_SUPPORT
	bool "Whole Home Coverage - Easy Setup"
	depends on MT_AP_SUPPORT
	depends on CHIP_MT7615E && !MT76XX_COMBO_DUAL_DRIVER_SUPPORT
	default n    

config EVENT_NOTIFIER_SUPPORT
	bool "Whole Home Coverage - Event Notifier"
	depends on MT_AP_SUPPORT
	depends on CHIP_MT7615E && !MT76XX_COMBO_DUAL_DRIVER_SUPPORT
	default n

config AIR_MONITOR
	bool "Air Monitor"
	depends on MT_AP_SUPPORT
	default n

config WNM_SUPPORT
	bool "802.11v WNM Support"
	depends on MT_AP_SUPPORT
	default n

config CUSTOMER_VENDOR_IE_SUPPORT
	bool "Customer Vendor IE support"
	depends on MT_AP_SUPPORT
	depends on CHIP_MT7663E
	default n

#config ROAMING_ENHANCE_SUPPORT
#	bool "Roaming Enhance Support"
#	depends on MT_AP_SUPPORT
#	depends on APCLI_SUPPORT
#	default n

#config WIFI_FWD_SUPPORT
#        bool "WiFi Forwarding Support"
#        default n

config WPA3_SUPPORT
	bool "WPA3 support"
	depends on MT_AP_SUPPORT
	default y

config OWE_SUPPORT
	bool "Enhance OPEN(OWE) support"
	depends on MT_AP_SUPPORT
	depends on WPA3_SUPPORT
	default y

config APCLI_CONNECTION_TRIAL
        bool "Trial Connection"
        depends on MT_AP_SUPPORT
        depends on APCLI_SUPPORT
        default n

config VENDOR_FEATURE11_SUPPORT
	bool "Vendor11 Feature Enable"
	depends on WIFI_DRIVER
	depends on MT_AP_SUPPORT
	default n
config IXIA_SUPPORT
	bool "IXIA Test Configure"
	depends on WIFI_DRIVER
	depends on MT_AP_SUPPORT
	default n
```

## openwrt/package/mtk/sf/sf-drv/src/Kconfig
```kconfig
config MT7622_SF
	tristate "MT7622/29 serial flash helper"
	help
	  Helper driver used for MT7622/29 to access extra serial falsh features
	  e.g. Unique ID and SFDP
```

## uboot/board/mediatek/common/Kconfig
```kconfig
config MEDIATEK_BOOTMENU
	bool "Enable MediaTek bootmenu framework"
	select CMD_BOOTMENU
	default n
	help
	  Enable this option will allow boards to use a bootmenu containing
	  features for easy upgrading/booting.

config MEDIATEK_BOOTMENU_DELAY
	int "MediaTek bootmenu delay time (s)"
	range 1 10
	default 4
	depends on MEDIATEK_BOOTMENU
	help
	  The dealy seconds for the bootmenu to show before running the
	  default command.
```
