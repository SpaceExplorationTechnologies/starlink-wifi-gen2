;*****************************************************************************
;  Copyright Statement:
;  --------------------
;  This software is protected by Copyright and the information contained
;  herein is confidential. The software may not be copied and the information
;  contained herein may not be used or disclosed except with the written
;  permission of MediaTek Inc. (C) 2018
;
;*****************************************************************************
;;================================================
;; PURPOSE:     ASIC Bring Up
;; CREATE_DATE: 2018/04/01
;; NOTE: dehui.sun@mediatek.com

;=================================================
; Specify Core Number
;=================================================

;=================================================
; Initialize CPU
;=================================================
;system.down
system.reset
SYStem.OPTION TRST ON
SYSTEM.OPTION ENRESET ON
SYSTEM.OPTION RESBREAK OFF
SYSTEM.OPTION WAITRESET OFF

SYSTEM.JTAGCLOCK 10.MHz;

SYSTEM.CPU CortexA7MPCore

;;Setting Core debug register access

;;;setting Core debug register access
SYSTEM.CONFIG CORENUMBER 1;
SYSTEM.MULTICORE COREBASE 0x80810000;
;SYSTEM.CONFIG CTIBASE 0x80818000;
;SYSTEM.CONFIG PMUBASE 0x80811000;

SETUP.IMASKHLL ON
SETUP.IMASKASM ON

;=================================================
; Attach and Stop CPU
;=================================================
;;Must select AXI mode on Memory-Dump-View
;sys.mode prepare
;stop
SYStem.Up
wait 10.ms

;; share L2 sram 128KB for spl
;;D.S SD:0x10200618 %LE %LONG 0x00000000
D.S SD:0x102007f0 %LE %LONG 0x00000001

;; disable DABORT and PABORT breakpoint
tronchip.set dabort off
tronchip.set pabort off
tronchip.set undef off
tronchip.set irq off

Break.Delete /ALL

D.S C15:0x1 0				; Turn off MMU

;; disable wdt (debug purpose)
D.S SD:0x10212000 %LE %LONG 0x22000000

;=================================================
; Print : Hello World
;=================================================
;; print uart log: Hello,MT7626 (115200n1)
d.s c:0x11002024 %le %long 0x00
d.s c:0x1100200c %le %long 0x80
d.s c:0x11002004 %le %long 0x00
d.s c:0x11002000 %le %long 0x16
d.s c:0x1100200c %le %long 0x03
d.s c:0x11002028 %le %long 0x0f
d.s c:0x1100202c %le %long 0x07
d.s c:0x11002000 %le %long 0x0d ;CR
d.s c:0x11002000 %le %long 0x0a ;LF
d.s c:0x11002000 %le %long 0x48 ;H
d.s c:0x11002000 %le %long 0x65 ;e
d.s c:0x11002000 %le %long 0x6c ;l
d.s c:0x11002000 %le %long 0x6c ;l
d.s c:0x11002000 %le %long 0x6f ;o
d.s c:0x11002000 %le %long 0x2c ;,
d.s c:0x11002000 %le %long 0x20 ;
d.s c:0x11002000 %le %long 0x4d ;M
d.s c:0x11002000 %le %long 0x54 ;T
d.s c:0x11002000 %le %long 0x37 ;7
d.s c:0x11002000 %le %long 0x36 ;6
d.s c:0x11002000 %le %long 0x32 ;2
d.s c:0x11002000 %le %long 0x36 ;6
d.s c:0x11002000 %le %long 0x0d ;CR
d.s c:0x11002000 %le %long 0x0a ;LF

print "Print UART log done."

;=================================================
; Load u-boot-spl.elf to run firstly and then
; wait dramK-init OK.
; Load u-boot.img to dram and spl jumps to uboot entry.
; Load flashimage.bin or u-boot-mtk.bin by ICE.
;=================================================
D.LOAD.ELF .\u-boot-spl-ram.elf   /gnu /noclear


core.select 0
r.s pc 0x00201000       ;SPL entry

;; Set breakpoint at spl_boot_device()
Break.RESet
Break.Set spl_boot_device   /Onchip

go
wait 6000.ms
break

D.LOAD.BINARY .\u-boot.img 0x41DFFFC0      /noclear

print "ICE load flashimage.bin"
;D.LOAD.BINARY .\u-boot-mtk.bin 0x40000000  /noclear
;D.LOAD.BINARY .\flashimage.bin 0x40000000  /noclear

print "ICE load lede-kernel.bin"
;; CONFIG_SYS_LOAD_ADDR = 0x41007F1C,
;D.LOAD.BINARY .\lede-kernel.bin 0x41007F1C  /noclear

go
